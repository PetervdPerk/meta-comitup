## conf/layer.conf
```bitbake
# We have a conf and classes directory, append to BBPATH
BBPATH .= ":${LAYERDIR}"

# We have a recipes directory containing .bb and .bbappend files, add to BBFILES
BBFILES += "${LAYERDIR}/recipes*/*/*.bb \
            ${LAYERDIR}/recipes*/*/*.bbappend"

BBFILE_COLLECTIONS += "comitup"
BBFILE_PATTERN_comitup := "^${LAYERDIR}/"
BBFILE_PRIORITY_comitup = "9"

LAYERSERIES_COMPAT_comitup = "sumo thud"
```
